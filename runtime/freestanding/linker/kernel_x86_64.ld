/*
 * =============================================================================
 * ملف: kernel_x86_64.ld
 * الوصف: سكريبت رابط لنواة لغة ص — معمارية x86_64
 * المهمة: دعم Freestanding في لغة ص
 * =============================================================================
 *
 * هذا السكريبت يُحدِّد تخطيط ذاكرة النواة في وضع Freestanding
 * على المعمارية x86_64.
 *
 * التخطيط الافتراضي:
 * ─────────────────────────────────────────────────────
 *   1 ميغابايت   | 0x00100000 | LOAD_ADDR | نقطة التحميل
 *   .text         | قابل للتنفيذ | كود النواة
 *   .rodata       | للقراءة فقط | بيانات ثابتة + نصوص
 *   .data         | قراءة/كتابة | متغيرات مُهيّأة
 *   .bss          | صفر         | متغيرات غير مُهيّأة
 *   .stack        | 16 ك ب      | مكدس النواة
 * ─────────────────────────────────────────────────────
 *
 * للاستخدام مع:
 *   sadc --حرّ --سكربت-الرابط=kernel_x86_64.ld kernel.ص -o kernel.elf
 *
 * أو مع ld مباشرةً:
 *   ld -T kernel_x86_64.ld kernel.o -o kernel.elf
 *
 * ملاحظة: عدّل KERNEL_LOAD_ADDR حسب بيئتك:
 *   - GRUB/Multiboot:  0x00100000 (1 MB)
 *   - UEFI:            عادةً 0xFFFFFFFF80000000 (منطقة عالية)
 *   - RISC-V/ARM:      يعتمد على لوحة التطوير
 * =============================================================================
 */

/* ─── نقطة الدخول ─────────────────────────────────────────────────────────── */
/* اسم رمز نقطة الدخول كما هو مُعرَّف بـ #[نقطة_دخول] في كود لغة ص           */
/* Entry symbol as defined with #[entry_point] in Sad source code             */
ENTRY(_start)

/* ─── عنوان التحميل ────────────────────────────────────────────────────────── */
/* GRUB Multiboot: تُحمَّل النواة على 1 ميغابايت                               */
/* Multiboot standard: kernel loaded at 1MB                                   */
KERNEL_LOAD_ADDR = 0x00100000;

/* ─── تخطيط الأقسام ────────────────────────────────────────────────────────── */
SECTIONS
{
    /*
     * نقطة البداية — نبدأ من KERNEL_LOAD_ADDR
     * Start point — begin from KERNEL_LOAD_ADDR
     */
    . = KERNEL_LOAD_ADDR;

    /* ───────────────────────────────────────────────────────────────────────
     * قسم .text — كود النواة القابل للتنفيذ
     * .text section — executable kernel code
     *
     * يحتوي:
     *   - كود جميع الدوال
     *   - نقطة الدخول _start
     *   - معالجات المقاطعات
     *   - باقي الكود المُولَّد من لغة ص
     * ─────────────────────────────────────────────────────────────────────── */
    .text : ALIGN(4096)
    {
        /* نبدأ بجدول Multiboot Header إن وُجد */
        KEEP(*(.multiboot_header))

        /* نقطة الدخول الرئيسية */
        *(.text._start)
        *(.text.entry)

        /* معالجات المقاطعات والاستثناءات */
        *(.text.interrupt_handlers)
        *(.text.exception_handlers)

        /* باقي الكود */
        *(.text*)
        *(.gnu.linkonce.t*)
    }

    /* ───────────────────────────────────────────────────────────────────────
     * قسم .rodata — البيانات الثابتة للقراءة فقط
     * .rodata section — read-only constant data
     *
     * يحتوي:
     *   - النصوص الثابتة (رسائل الخطأ، أسماء الدوال...)
     *   - الثوابت المُهيّأة وقت الترجمة
     *   - جداول معالجات المقاطعات (IDT entries للثوابت)
     * ─────────────────────────────────────────────────────────────────────── */
    .rodata : ALIGN(4096)
    {
        *(.rodata*)
        *(.gnu.linkonce.r*)

        /* نصوص رسائل lة ص الثابتة */
        *(.sad_strings*)
    }

    /*
     * حفظ عنوان نهاية النصوص الثابتة (لاحتياجات debugger)
     * Save end of read-only sections (for debugger needs)
     */
    . = ALIGN(4096);
    _kernel_rodata_end = .;

    /* ───────────────────────────────────────────────────────────────────────
     * قسم .data — المتغيرات المُهيّأة (قراءة/كتابة)
     * .data section — initialized read-write variables
     *
     * يحتوي:
     *   - المتغيرات العامة المُهيّأة بقيم غير صفرية
     *   - جداول مؤشرات الدوال
     * ─────────────────────────────────────────────────────────────────────── */
    .data : ALIGN(4096)
    {
        _data_start = .;

        *(.data*)
        *(.gnu.linkonce.d*)

        _data_end = .;
    }

    /* ───────────────────────────────────────────────────────────────────────
     * قسم .bss — المتغيرات غير المُهيّأة (تُصفَّر وقت التشغيل)
     * .bss section — uninitialized variables (zeroed at runtime)
     *
     * هذا القسم لا يأخذ مساحة في ملف ELF — فقط رموز تُعرَّف موضعها.
     * كود _start يجب أن يُصفِّره يدوياً:
     *   sad_memzero(&_bss_start, &_bss_end - &_bss_start);
     *
     * This section takes no space in ELF file — only symbols define its range.
     * _start code must zero it manually using sad_memzero().
     * ─────────────────────────────────────────────────────────────────────── */
    .bss : ALIGN(4096)
    {
        _bss_start = .;

        *(.bss*)
        *(.gnu.linkonce.b*)
        *(COMMON)

        _bss_end = .;
    }

    /* ───────────────────────────────────────────────────────────────────────
     * قسم .stack — مكدس النواة
     * .stack section — kernel stack
     *
     * 16 ك ب افتراضياً. يمكن زيادته حسب احتياج النواة.
     * _start يُعيّن: mov rsp, stack_top
     *
     * Default 16KB. Adjust based on kernel needs.
     * _start sets: mov rsp, stack_top
     * ─────────────────────────────────────────────────────────────────────── */
    .stack : ALIGN(4096)
    {
        _stack_bottom = .;
        . += 16384;     /* 16 ك ب = 16 * 1024 بايت */
        _stack_top = .;
    }

    /*
     * نهاية النواة في الذاكرة
     * Kernel end in memory
     */
    . = ALIGN(4096);
    _kernel_end = .;

    /* ───────────────────────────────────────────────────────────────────────
     * تجاهل أقسام التصحيح (اختياري — أبقها للـ debugger)
     * Discard debug sections (optional — keep for debugger)
     *
     * لتقليل حجم الصورة النهائية، أزل التعليق عن السطر التالي:
     * To reduce final image size, uncomment the following:
     * ─────────────────────────────────────────────────────────────────────── */
    /DISCARD/ :
    {
        /* ملاحظة: نحتفظ بمعلومات التصحيح افتراضياً للمساعدة في التطوير */
        /* Note: We keep debug info by default to help with development  */

        /* احذف هذه الأقسام الغير ضرورية للـ bare-metal */
        *(.eh_frame*)         /* معلومات unwind — غير مطلوبة في freestanding */
        *(.gcc_except_table*) /* جداول استثناءات gcc */
        *(.note.gnu.build-id) /* BUILD-ID غير ضروري */
        *(.comment)           /* تعليقات المترجم */
    }
}

/*
 * =============================================================================
 * رموز مُصدَّرة للاستخدام في كود لغة ص
 * Exported symbols for use in Sad language code
 * =============================================================================
 *
 * يمكن الوصول لهذه الرموز في كود لغة ص كمتغيرات خارجية:
 *
 *   خارجي ع8* بداية_bss;                // extern u8* bss_start
 *   خارجي ع8* نهاية_bss;                // extern u8* bss_end
 *   خارجي ع8* نهاية_النواة;             // extern u8* kernel_end
 *   خارجي ع8* قمة_المكدس;              // extern u8* stack_top
 *
 * في دالة _start():
 *   // تصفير قسم bss
 *   sad_memzero(بداية_bss, نهاية_bss - بداية_bss);
 *   // تعيين المكدس
 *   // (يتم في كود التجميع قبل استدعاء _start العالي المستوى)
 * =============================================================================
 */
